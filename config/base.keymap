#include <behaviors.dtsi>
#include <dt-bindings/zmk/keys.h>
#include <dt-bindings/zmk/bt.h>
#include "node-free/helper.h"

#define DEF     0
#define NAV     1
#define FN      2
#define NUM     3
#define SYS     4

#include "combos.dtsi"
#include "node-free/extra_keys.h"

ZMK_CONDITIONAL_LAYER(FN NAV, SYS)  // FN + NAV --> SYS

/* Navigation keys and misc shortcuts */

&mt {
    flavor = "tap-preferred";
    tapping-term-ms = <220>;
    quick-tap-ms = <220>;                // repeat on tap-into-hold
    hold-trigger-key-positions = <0>;    // tap on interrupt
};

ZMK_BEHAVIOR(nav_left, mod_morph,
    bindings = <&kp LEFT>, <&kp HOME>;
    mods = <(MOD_LSFT)>;
)

ZMK_BEHAVIOR(nav_right, mod_morph,
    bindings = <&kp RIGHT>, <&kp END>;
    mods = <(MOD_LSFT)>;
)

ZMK_BEHAVIOR(nav_up, mod_morph,
    bindings = <&kp UP>, <&kp LC(HOME)>;
    mods = <(MOD_LSFT)>;
)

ZMK_BEHAVIOR(nav_down, mod_morph,
    bindings = <&kp DOWN>, <&kp LC(END)>;
    mods = <(MOD_LSFT)>;
)

ZMK_BEHAVIOR(nav_bspc, mod_morph,
    bindings = <&kp BSPC>, <&kp LC(BSPC)>;
    mods = <(MOD_LSFT)>;
)

ZMK_BEHAVIOR(nav_del, mod_morph,
    bindings = <&kp DEL>, <&kp LC(DEL)>;
    mods = <(MOD_LSFT)>;
)

#define NAV_LEFT    &nav_left    // tap: left  | shift-tap: beginning of line
#define NAV_RIGHT   &nav_right   // tap: right | shift-tap: end       of line
#define NAV_UP      &nav_up      // tap: up    | shift-tap: beginning of document
#define NAV_DOWN    &nav_down    // tap: down  | shift-tap: end       of document
#define NAV_BSPC    &nav_bspc    // tap: bspc  | shift-tap: delete word backward
#define NAV_DEL     &nav_del     // tap: del   | shift-tap: delete word forward

#define XXX &none
#define ___ &trans

#define CANCEL      &kp K_CANCEL            // cancel caps-word, num-word, and smart mouse
#define HYPER       &sk LG(LS(LC(LALT)))

/* Settings */

#define QUICK_TAP_MS 175

&sk {   // sticky-key config
    release-after-ms = <600>;       // release after 0.6s
    quick-release;                  // no double capitalization when rolling keys
};

&sl {   // sticky-layer config
    ignore-modifiers;
};

&lt {   // layer-tap config
    flavor = "balanced";
    tapping-term-ms = <200>;
    quick-tap-ms = <QUICK_TAP_MS>;
};

&num_word { // num-word, requires PR #1441
    layers = <NUM>;
};

/* Homerow mods */

#define KEYS_L LT0 LT1 LT2 LT3 LT4 LM0 LM1 LM2 LM3 LM4 LB0 LB1 LB2 LB3 LB4  // Left hand side
#define KEYS_R RT0 RT1 RT2 RT3 RT4 RM0 RM1 RM2 RM3 RM4 RB0 RB1 RB2 RB3 RB4  // Right hand side
#define THUMBS LH2 LH1 LH0 RH0 RH1 RH2

ZMK_BEHAVIOR(hml, hold_tap, // left-hand HRMs
    flavor = "balanced";
    tapping-term-ms = <280>;
    quick-tap-ms = <QUICK_TAP_MS>;
    bindings = <&kp>, <&kp>;
    hold-trigger-key-positions = <KEYS_R THUMBS>;
)

ZMK_BEHAVIOR(hmr, hold_tap, // right-hand HRMs
    flavor = "balanced";
    tapping-term-ms = <280>;
    quick-tap-ms = <QUICK_TAP_MS>;
    bindings = <&kp>, <&kp>;
    hold-trigger-key-positions = <KEYS_L THUMBS>;
    hold-trigger-on-release;
)

/* Custom Behaviors */

// tap: num-word | double-tap: sticky num-layer | hold: num-layer
ZMK_BEHAVIOR(num_dance, tap_dance,
    tapping-term-ms = <200>;
    bindings = <&num_word>, <&sl NUM>;
)
ZMK_BEHAVIOR(num_layer_word, hold_tap,
    flavor = "balanced";
    tapping-term-ms = <200>;
    quick-tap-ms = <QUICK_TAP_MS>;
    bindings = <&mo>, <&num_dance>;
)
#define NUM_WORD &num_layer_word NUM 0

// tap: sticky-shift | shift + tap/double-tap: caps-word | hold: shift
ZMK_BEHAVIOR(ss_cw, mod_morph,
    bindings = <&sk LSHFT>, <&caps_word>;
    mods = <(MOD_LSFT)>;
)

// tap: backspace | lshft + tap: delete | rshft + tap: shift-delete | hold: fn layer
ZMK_BEHAVIOR(bs_del, mod_morph,
    bindings = <&kp BSPC>, <&kp DEL>;
    mods = <(MOD_LSFT|MOD_RSFT)>;
    keep-mods = <MOD_LSFT>;
)
ZMK_BEHAVIOR(lt_bspc, hold_tap,
    flavor = "balanced";
    tapping-term-ms = <200>;
    quick-tap-ms = <QUICK_TAP_MS>;
    bindings = <&mo>, <&bs_del>;
)

// tap: space | shift + tap: dot -> space -> sticky shift | hold: activate layer
ZMK_BEHAVIOR(dot_spc, macro,
    wait-ms = <0>;
    tap-ms = <5>;
    bindings = <&kp DOT &kp SPACE &sk LSHFT>;
)
ZMK_BEHAVIOR(spc_morph, mod_morph,
    bindings = <&kp SPACE>, <&dot_spc>;
    mods = <(MOD_LSFT|MOD_RSFT)>;
)
ZMK_BEHAVIOR(lt_spc, hold_tap,
    flavor = "balanced";
    tapping-term-ms = <QUICK_TAP_MS>;
    bindings = <&sl>, <&spc_morph>;
)

// tap: comma | shift + tap: semicolon | ctrl + shift + tap: <
ZMK_BEHAVIOR(comma_inner_morph, mod_morph,
    bindings = <&kp SEMICOLON>, <&kp LESS_THAN>;
    mods = <(MOD_LCTL|MOD_RCTL)>;
)
ZMK_BEHAVIOR(comma_morph, mod_morph,
    mods = <(MOD_LSFT|MOD_RSFT)>;
    bindings = <&kp COMMA>, <&comma_inner_morph>;
)

// tap: dot | shift + tap: colon | ctrl + shift + tap: >
ZMK_BEHAVIOR(dot_inner_morph, mod_morph,
    bindings = <&kp COLON>, <&kp GREATER_THAN>;
    mods = <(MOD_LCTL|MOD_RCTL)>;
)
ZMK_BEHAVIOR(dot_morph, mod_morph,
    bindings = <&kp DOT>, <&dot_inner_morph>;
    mods = <(MOD_LSFT|MOD_RSFT)>;
)

// tap: qmark | shift + tap: excl
ZMK_BEHAVIOR(qexcl, mod_morph,
    bindings = <&kp QMARK>, <&kp EXCL>;
    mods = <(MOD_LSFT|MOD_RSFT)>;
)

/* Keymaps */
#include "layers/dvorak.keymap"         // 0
#include "layers/nav.keymap"            // 1
#include "layers/fn.keymap"             // 2
#include "layers/num.keymap"            // 3
#include "layers/sys.keymap"            // 4