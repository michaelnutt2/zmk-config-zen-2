/* source keypos definitions */
#include "node-free/keypos_42keys.h"

#define CONFIG_WIRELESS 1

#define X_RB CANCEL
#define X_LT CANCEL
#define X_LM LSHIFT

#include "base.keymap"

/ { chosen { zmk,matrix_transform = &default_transform; }; };